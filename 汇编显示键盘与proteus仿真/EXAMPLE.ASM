LCD_RS EQU P2.0    ;1602控制
LCD_RW EQU P2.1    ;......
LCD_E  EQU P2.2    ;脉冲
LCD_D7 EQU P0.7    ;
LCD_DATA EQU P0    ;1602数据口
LCD_JISHU EQU 20H    ;1602写数据计数
LCD_CAIDAN EQU 21H    ;1602菜单编号
LCD_CAIDAN_YE EQU 22H    ;1602页编号
KEY_UP EQU P2.3    ;上键
KEY_DOWN EQU P2.4    ;下键
KEY_OK EQU P2.5    ;确认键
KEY_EXIT EQU P2.6    ;退出键
LCD_BEI EQU P2.7  ;1602背光
EXIT_BIAOZHI EQU 23H.0    ;计时器，中按退出会置一标志位
OK_BIAOZHI EQU 23H.1
UP_BIAOZHI EQU 23H.2
DOWN_BIAOZHI EQU 23H.3
DINGSHI_JISHU EQU 24H    ;用定时器延时计数
LED EQU P1	    ;
;数码管595    ;
MINGXIANG EQU P3.3
HC595_DATA EQU P3.4    ;数码管数据，移位输出，，，复用hc164数据口
HC595_SLCP EQU P3.5    ;读入数据端
HC595_SHCP EQU P3.6    ;刷新显示端，、、复用hc164的clk
HC595_SHI EQU 25H    ;时钟的时分秒
HC595_FEN EQU 26H    ;
HC595_MIAO EQU 27H    ;
;矩阵键盘.......
JIANPAN1 EQU P3.0
JIANPAN2 EQU P3.1
HC164_DATA EQU P3.4
HC164_CLK EQU P3.7
JIANSHUXU EQU 28H   ;矩阵键盘按下的顺序，
JISUANQI_DATA1 EQU 29H     ;
JISUANQI_YUNSUAN EQU 2AH     ;
JISUANQI_DATA2 EQU 2BH     ;
JISUANQI_JIEGUO1 EQU  2CH     ;
JISUANQI_JIEGUO2 EQU 2DH       ;
ANJIAN_CHANGAN EQU 2FH
OKCHANGAN_BIAOZHI EQU 23H.4   ;
HONGWAIZ_ EQU P3.2
HONGWAIZ_MA EQU 30H
LEDYANSHI_JISHU EQU 31H
ORG 0000H
        AJMP MAIN
		ORG 03H
		LJMP WAIBU0
		ORG 0BH
		LJMP T0DINGSHI
		ORG 001BH
		LJMP T1DINGSHI;定时器中断
        ORG 0030H
			MAIN:
			LCALL SHUMA_JIANCE
			LCALL SHUMA_QINGLING
			MOV HONGWAIZ_MA,#00H
			CLR LCD_BEI
			LCALL LCD_XIANSHI   ;1602初始化，欢迎界面
			SETB PT0 ;把定时器t1设置为高优先级
			MOV TMOD,#11H ;T1为工作方式一
			MOV IE,#8BH ;允许T1中断,T0,外部中断0
			MOV TH1,#0D8H ;放入数据
			MOV TL1,#0F0H
			MOV TH0,#0DBH
            MOV TL0,#0F0H
			SETB TR1    ;启动T1定时器
			LOOP0:
            LCALL ANJIAN_RENYI    ;按键判断
			SJMP LOOP0
		    SJMP $     
WAIBU0:
CLR  EA
PUSH 01H
PUSH 02H
PUSH 03H
PUSH 04H
PUSH  ACC
MOV A,HONGWAIZ_MA
CJNE A,#0,WAIBU0_JIESHU
;MOV ANJIAN_CHANGAN,#10
WAIBU0_LOOP8:
MOV R3,#10
WAIBU0_LOOP7:
LCALL DELAY840US
JB HONGWAIZ_,WAIBU0_JIESHU
DJNZ R3,WAIBU0_LOOP7
WAIBU0_LOOP13:
;MOV R1,ANJIAN_CHANGAN
;CJNE R1,#00H,WAIBU0_LOOP9
;WAIBU0_JIESHU_1:
;LJMP WAIBU0_JIESHU
WAIBU0_LOOP9:
JNB HONGWAIZ_,WAIBU0_LOOP13
LCALL DELAY4MS750US
MOV R4,#8H
MOV R3,#4H
WAIBU0_LOOP1:
;MOV R1,ANJIAN_CHANGAN
;CJNE R1,#00H,WAIBU0_LOOP10
;LJMP WAIBU0_JIESHU
WAIBU0_LOOP10:
JNB HONGWAIZ_,WAIBU0_LOOP1
LCALL DELAY840US
JB HONGWAIZ_,WAIBU0_LOOP0
CLR ACC.0
RLC A
DJNZ R4,WAIBU0_LOOP1
LJMP WAIBU0_LOOP2
WAIBU0_LOOP0:
SETB ACC.0
RLC A
WAIBU0_LOOP11:
;MOV R1,ANJIAN_CHANGAN
;CJNE R1,#00H,WAIBU0_LOOP12
;LJMP WAIBU0_JIESHU
WAIBU0_LOOP12:
JB HONGWAIZ_,WAIBU0_LOOP11
DJNZ R4,WAIBU0_LOOP1
WAIBU0_LOOP2:
RRC A
CJNE R3,#04H,WAIBU0_LOOP3
CJNE A,#00H,WAIBU0_JIESHU
LJMP WAIBU0_LOOP6
WAIBU0_LOOP3:
CJNE R3,#03H,WAIBU0_LOOP4
CJNE A,#0FFH,WAIBU0_JIESHU
LJMP WAIBU0_LOOP6
WAIBU0_LOOP4:
CJNE R3,#02H,WAIBU0_LOOP5
MOV R2,A
LJMP WAIBU0_LOOP6
WAIBU0_LOOP5:
CJNE R3,#01H,WAIBU0_LOOP6
ADD A,R2
CJNE A,#0FFH,WAIBU0_JIESHU
CJNE R2,#30H,WAIBU0_HONGWAI_J2
MOV HONGWAIZ_MA,#01H
WAIBU0_HONGWAI_J2:
CJNE R2,#18H,WAIBU0_HONGWAI_J3
MOV HONGWAIZ_MA,#02H
WAIBU0_HONGWAI_J3:
CJNE R2,#7AH,WAIBU0_HONGWAI_J4
MOV HONGWAIZ_MA,#03H
WAIBU0_HONGWAI_J4:
CJNE R2,#10H,WAIBU0_JIESHU
MOV HONGWAIZ_MA,#04H
LJMP WAIBU0_JIESHU
WAIBU0_LOOP6:
MOV R4,#08H  
DJNZ R3,WAIBU0_LOOP1
LJMP WAIBU0_JIESHU
WAIBU0_JIESHU:
POP ACC
POP 04H
POP 03H
POP 02H
POP 01H
SETB EA
CLR IE0
RETI

T0DINGSHI:
MOV TH0,#0DBH
MOV TL0,#0F0H
PUSH ACC
MOV A,ANJIAN_CHANGAN
CJNE A,#0H,T0DINGSHI_LOOP1
CLR TR0
POP ACC
RETI
T0DINGSHI_LOOP1:
DEC A
MOV ANJIAN_CHANGAN,A  ;
POP ACC
RETI


SHUMA_JIANCE:
MOV R3,#00H
SHUMA_JIANCE_LOOP1:
MOV HC595_SHI,R3
MOV HC595_FEN,R3
MOV HC595_MIAO,R3
LCALL SHUMA_XIANSHI
LCALL DELAY100MS
INC R3
MOV A,R3
SWAP A
INC A
MOV R3,A
CJNE R3,#0AAH,SHUMA_JIANCE_LOOP1
MOV HC595_SHI,#0H
MOV HC595_FEN,#0H
MOV HC595_MIAO,#0H
RET
FENGMING:	CLR MINGXIANG
			LCALL DELAY10MS
			SETB MINGXIANG
			RET
;计算器部分，，，，，
JISUANQI:   
CLR EXIT_BIAOZHI  ;清除退出标志位
SETB JIANPAN1
SETB JIANPAN2
MOV A,#38H
LCALL LCD_XIEMINGLING  ;开光标
MOV A,#0FH
LCALL LCD_XIEMINGLING  ;开光标
MOV A,#07H
LCALL LCD_XIEMINGLING  ;写入一个数据，屏幕左移
JISUANQI_LOOP17:
MOV A,#01H
LCALL LCD_XIEMINGLING  ;清屏
MOV A,#8FH
LCALL LCD_XIEMINGLING ;定位光标第一行最后一个
MOV JIANSHUXU,#1H

JISUANQI_LOOP16:
LCALL JIANPAN_PANDUAN  ;判断矩阵键盘按键，将键值保存到A
LCALL FENGMING
JBC EXIT_BIAOZHI,JISUANQI_JIESHU1     ;若有退出标志，退出程序
CJNE A,#00H,JISUANQI_LOOP1     ;跳转到对应子程序
LCALL JISUANQI_ANJIAN0     ;
LJMP JISUANQI_LOOP16     ;
JISUANQI_LOOP1:
CJNE A,#01H,JISUANQI_LOOP2     ;
LCALL JISUANQI_ANJIAN1
LJMP JISUANQI_LOOP16     ;
JISUANQI_LOOP2:
CJNE A,#02H,JISUANQI_LOOP3     ;
LCALL JISUANQI_ANJIAN2
LJMP JISUANQI_LOOP16     ;
JISUANQI_LOOP3:
CJNE A,#03H,JISUANQI_LOOP4     ;
LCALL JISUANQI_ANJIAN3
LJMP JISUANQI_LOOP16     ;
JISUANQI_JIESHU1:
LJMP JISUANQI_JIESHU     ;
JISUANQI_LOOP4:
CJNE A,#04H,JISUANQI_LOOP5     ;
LCALL JISUANQI_ANJIAN4
LJMP JISUANQI_LOOP16
JISUANQI_LOOP5:
CJNE A,#05H,JISUANQI_LOOP6     ;
LCALL JISUANQI_ANJIAN5
LJMP JISUANQI_LOOP16
JISUANQI_LOOP6:
CJNE A,#06H,JISUANQI_LOOP7     ;
LCALL JISUANQI_ANJIAN6
LJMP JISUANQI_LOOP16
JISUANQI_LOOP7:
CJNE A,#07H,JISUANQI_LOOP8     ;
LCALL JISUANQI_ANJIAN7
LJMP JISUANQI_LOOP16
JISUANQI_LOOP8:
CJNE A,#08H,JISUANQI_LOOP9     ;
LCALL JISUANQI_ANJIAN8
LJMP JISUANQI_LOOP16
JISUANQI_LOOP9:
CJNE A,#09H,JISUANQI_LOOP10     ;
LCALL JISUANQI_ANJIAN9
LJMP JISUANQI_LOOP16
JISUANQI_LOOP10:
CJNE A,#0AH,JISUANQI_LOOP11     ;
LCALL JISUANQI_ANJIANJIA
LJMP JISUANQI_LOOP16
JISUANQI_LOOP11:
CJNE A,#0BH,JISUANQI_LOOP12     ;
LCALL JISUANQI_ANJIANJIAN
LJMP JISUANQI_LOOP16
JISUANQI_LOOP12:
CJNE A,#0CH,JISUANQI_LOOP13     ;
LCALL JISUANQI_ANJIANCHENG
LJMP JISUANQI_LOOP16
JISUANQI_LOOP13:
CJNE A,#0DH,JISUANQI_LOOP14     ;
LCALL JISUANQI_ANJIANCHU
LJMP JISUANQI_LOOP16
JISUANQI_LOOP14:
CJNE A,#0EH,JISUANQI_LOOP15     ;
LJMP JISUANQI_LOOP17
JISUANQI_LOOP15:
CJNE A,#0FH,JISUANQI_LOOP16_1     ;
LCALL JISUANQI_ANJIANDENG
JISUANQI_LOOP16_1:
LJMP JISUANQI_LOOP16
JISUANQI_JIESHU:
RET

JISUANQI_ANJIAN0:
MOV A,JIANSHUXU
CJNE A,#1H,JISUANQI_ANJIAN0_LOOP0     ;判断是第几次输入，将值放到data1或data2
MOV JISUANQI_DATA1,#0H
MOV DPTR,#BIAO_LCD_JISUANQI_ZIFU     ;将计算器的data赋值
MOV A,#0H
MOVC A,@A+DPTR
LCALL LCD_XIESHUJU
INC JIANSHUXU
RET
JISUANQI_ANJIAN0_LOOP0:
CJNE A,#3H,JISUANQI_ANJIAN0_LOOP1     ;
MOV JISUANQI_DATA2,#0H
MOV DPTR,#BIAO_LCD_JISUANQI_ZIFU     ;
MOV A,#0H
MOVC A,@A+DPTR
LCALL LCD_XIESHUJU
INC JIANSHUXU
JISUANQI_ANJIAN0_LOOP1:
RET
JISUANQI_ANJIAN1:
MOV A,JIANSHUXU
CJNE A,#1H,JISUANQI_ANJIAN1_LOOP0     ;
MOV JISUANQI_DATA1,#1H
MOV DPTR,#BIAO_LCD_JISUANQI_ZIFU     ;
MOV A,#1H
MOVC A,@A+DPTR
LCALL LCD_XIESHUJU
INC JIANSHUXU
RET
JISUANQI_ANJIAN1_LOOP0:
CJNE A,#3H,JISUANQI_ANJIAN1_LOOP1     ;
MOV JISUANQI_DATA2,#1H
MOV DPTR,#BIAO_LCD_JISUANQI_ZIFU     ;
MOV A,#1H
MOVC A,@A+DPTR
LCALL LCD_XIESHUJU     ;
INC JIANSHUXU
JISUANQI_ANJIAN1_LOOP1:     ;
RET
JISUANQI_ANJIAN2:
MOV A,JIANSHUXU
CJNE A,#1H,JISUANQI_ANJIAN2_LOOP0     ;
MOV JISUANQI_DATA1,#2H
MOV DPTR,#BIAO_LCD_JISUANQI_ZIFU     ;
MOV A,#2H
MOVC A,@A+DPTR
LCALL LCD_XIESHUJU
INC JIANSHUXU
RET
JISUANQI_ANJIAN2_LOOP0:
CJNE A,#3H,JISUANQI_ANJIAN2_LOOP1     ;
MOV JISUANQI_DATA2,#2H
MOV DPTR,#BIAO_LCD_JISUANQI_ZIFU     ;
MOV A,#2H
MOVC A,@A+DPTR
LCALL LCD_XIESHUJU
INC JIANSHUXU
JISUANQI_ANJIAN2_LOOP1:
RET
JISUANQI_ANJIAN3:
MOV A,JIANSHUXU
CJNE A,#1H,JISUANQI_ANJIAN3_LOOP0     ;
MOV JISUANQI_DATA1,#3H
MOV DPTR,#BIAO_LCD_JISUANQI_ZIFU     ;
MOV A,#3H
MOVC A,@A+DPTR
LCALL LCD_XIESHUJU
INC JIANSHUXU
RET
JISUANQI_ANJIAN3_LOOP0:
CJNE A,#3H,JISUANQI_ANJIAN3_LOOP1     ;
MOV JISUANQI_DATA2,#3H
MOV DPTR,#BIAO_LCD_JISUANQI_ZIFU     ;
MOV A,#3H
MOVC A,@A+DPTR
LCALL LCD_XIESHUJU
INC JIANSHUXU
JISUANQI_ANJIAN3_LOOP1:
RET
JISUANQI_ANJIAN4:
MOV A,JIANSHUXU
CJNE A,#1H,JISUANQI_ANJIAN4_LOOP0     ;
MOV JISUANQI_DATA1,#4H
MOV DPTR,#BIAO_LCD_JISUANQI_ZIFU     ;
MOV A,#4H
MOVC A,@A+DPTR
LCALL LCD_XIESHUJU
INC JIANSHUXU
RET
JISUANQI_ANJIAN4_LOOP0:
CJNE A,#3H,JISUANQI_ANJIAN4_LOOP1     ;
MOV JISUANQI_DATA2,#4H
MOV DPTR,#BIAO_LCD_JISUANQI_ZIFU     ;
MOV A,#4H
MOVC A,@A+DPTR
LCALL LCD_XIESHUJU     ;
INC JIANSHUXU
JISUANQI_ANJIAN4_LOOP1:
RET
JISUANQI_ANJIAN5:
MOV A,JIANSHUXU
CJNE A,#1H,JISUANQI_ANJIAN5_LOOP0     ;
MOV JISUANQI_DATA1,#5H
MOV DPTR,#BIAO_LCD_JISUANQI_ZIFU     ;
MOV A,#5H
MOVC A,@A+DPTR
LCALL LCD_XIESHUJU     ;
INC JIANSHUXU
RET
JISUANQI_ANJIAN5_LOOP0:
CJNE A,#3H,JISUANQI_ANJIAN5_LOOP1     ;
MOV JISUANQI_DATA2,#5H
MOV DPTR,#BIAO_LCD_JISUANQI_ZIFU     ;
MOV A,#5H
MOVC A,@A+DPTR
LCALL LCD_XIESHUJU     ;
INC JIANSHUXU
JISUANQI_ANJIAN5_LOOP1:
RET
JISUANQI_ANJIAN6:
MOV A,JIANSHUXU     ;
CJNE A,#1H,JISUANQI_ANJIAN6_LOOP0     ;
MOV JISUANQI_DATA1,#6H
MOV DPTR,#BIAO_LCD_JISUANQI_ZIFU     ;
MOV A,#6H
MOVC A,@A+DPTR
LCALL LCD_XIESHUJU
INC JIANSHUXU
RET
JISUANQI_ANJIAN6_LOOP0:
CJNE A,#3H,JISUANQI_ANJIAN6_LOOP1     ;
MOV JISUANQI_DATA2,#6H
MOV DPTR,#BIAO_LCD_JISUANQI_ZIFU     ;
MOV A,#6H
MOVC A,@A+DPTR
LCALL LCD_XIESHUJU
INC JIANSHUXU
JISUANQI_ANJIAN6_LOOP1:
RET
JISUANQI_ANJIAN7:
MOV A,JIANSHUXU
CJNE A,#1H,JISUANQI_ANJIAN7_LOOP0     ;
MOV JISUANQI_DATA1,#7H
MOV DPTR,#BIAO_LCD_JISUANQI_ZIFU     ;
MOV A,#7H     ;
MOVC A,@A+DPTR
LCALL LCD_XIESHUJU     ;
INC JIANSHUXU
RET
JISUANQI_ANJIAN7_LOOP0:
CJNE A,#3H,JISUANQI_ANJIAN7_LOOP1     ;
MOV JISUANQI_DATA2,#7H     ;
MOV DPTR,#BIAO_LCD_JISUANQI_ZIFU     ;
MOV A,#7H
MOVC A,@A+DPTR
LCALL LCD_XIESHUJU     ;
INC JIANSHUXU
JISUANQI_ANJIAN7_LOOP1:
RET
JISUANQI_ANJIAN8:
MOV A,JIANSHUXU
CJNE A,#1H,JISUANQI_ANJIAN8_LOOP0     ;
MOV JISUANQI_DATA1,#8H
MOV DPTR,#BIAO_LCD_JISUANQI_ZIFU     ;
MOV A,#8H     ;
MOVC A,@A+DPTR
LCALL LCD_XIESHUJU
INC JIANSHUXU
RET
JISUANQI_ANJIAN8_LOOP0:
CJNE A,#3H,JISUANQI_ANJIAN8_LOOP1     ;
MOV JISUANQI_DATA2,#8H
MOV DPTR,#BIAO_LCD_JISUANQI_ZIFU     ;
MOV A,#8H
MOVC A,@A+DPTR
LCALL LCD_XIESHUJU
INC JIANSHUXU
JISUANQI_ANJIAN8_LOOP1:
RET
JISUANQI_ANJIAN9:
MOV A,JIANSHUXU
CJNE A,#1H,JISUANQI_ANJIAN9_LOOP0     ;
MOV JISUANQI_DATA1,#9H
MOV DPTR,#BIAO_LCD_JISUANQI_ZIFU     ;
MOV A,#9H
MOVC A,@A+DPTR
LCALL LCD_XIESHUJU
INC JIANSHUXU
RET
JISUANQI_ANJIAN9_LOOP0:     ;
CJNE A,#3H,JISUANQI_ANJIAN9_LOOP1     ;
MOV JISUANQI_DATA2,#9H
MOV DPTR,#BIAO_LCD_JISUANQI_ZIFU     ;
MOV A,#9H
MOVC A,@A+DPTR
LCALL LCD_XIESHUJU
INC JIANSHUXU
JISUANQI_ANJIAN9_LOOP1:
RET
JISUANQI_ANJIANJIA:     ;
MOV A,JIANSHUXU
CJNE A,#2H,JISUANQI_ANJIANJIA_LOOP0     ;第二次输入的为运算符，
MOV JISUANQI_YUNSUAN,#1H   ;运算符+-*/对应1234
MOV DPTR,#BIAO_LCD_JISUANQI_ZIFU     ;
MOV A,#0AH
MOVC A,@A+DPTR
LCALL LCD_XIESHUJU   ;将对应的字符在1602显示出来
INC JIANSHUXU
JISUANQI_ANJIANJIA_LOOP0:
RET
JISUANQI_ANJIANJIAN:
MOV A,JIANSHUXU
CJNE A,#2H,JISUANQI_ANJIANJIAN_LOOP0     ;
MOV JISUANQI_YUNSUAN,#2H
MOV DPTR,#BIAO_LCD_JISUANQI_ZIFU     ;
MOV A,#0BH
MOVC A,@A+DPTR
LCALL LCD_XIESHUJU
INC JIANSHUXU
JISUANQI_ANJIANJIAN_LOOP0:
RET
JISUANQI_ANJIANCHENG:
MOV A,JIANSHUXU
CJNE A,#2H,JISUANQI_ANJIANCHENG_LOOP0     ;
MOV JISUANQI_YUNSUAN,#3H     ;
MOV DPTR,#BIAO_LCD_JISUANQI_ZIFU
MOV A,#0CH
MOVC A,@A+DPTR
LCALL LCD_XIESHUJU
INC JIANSHUXU
JISUANQI_ANJIANCHENG_LOOP0:
RET
JISUANQI_ANJIANCHU:
MOV A,JIANSHUXU
CJNE A,#2H,JISUANQI_ANJIANCHU_LOOP0     ;
MOV JISUANQI_YUNSUAN,#4H
MOV DPTR,#BIAO_LCD_JISUANQI_ZIFU     ;
MOV A,#0DH
MOVC A,@A+DPTR
LCALL LCD_XIESHUJU
INC JIANSHUXU
JISUANQI_ANJIANCHU_LOOP0:
RET
JISUANQI_ANJIANDENG_LOOP0_1:     ;
LJMP JISUANQI_ANJIANDENG_LOOP0
JISUANQI_ANJIANDENG:
MOV A,JIANSHUXU
CJNE A,#4H,JISUANQI_ANJIANDENG_LOOP0_1     ;
MOV A,#0CFH
LCALL LCD_XIEMINGLING  ;定位光标
MOV DPTR,#BIAO_LCD_JISUANQI_ZIFU     ;
MOV A,#0EH
MOVC A,@A+DPTR
LCALL LCD_XIESHUJU     ;写等号
LCALL JISUANQI_JIEGUO     ;结果运算
MOV A,JISUANQI_YUNSUAN     ;根据不同的运算，显示出不同形式的字符
CJNE A,#4H,JISUANQI_ANJIANDENG_LOOP1     ;是/除运算
MOV A,JISUANQI_JIEGUO1     ;jieguo1是整数部分，jieguo2是小数部分
ADD A,#30H
LCALL LCD_XIESHUJU     
MOV A,#0FH
MOVC A,@A+DPTR
LCALL LCD_XIESHUJU     ;显示.
MOV A,JISUANQI_JIEGUO2     ;
ANL A,#0F0H
SWAP A
ADD A,#30H
LCALL LCD_XIESHUJU     ;
MOV A,JISUANQI_JIEGUO2     ;
ANL A,#0FH
ADD A,#30H
LCALL LCD_XIESHUJU     ;
INC JIANSHUXU
MOV A,#1CH
LCALL LCD_XIEMINGLING     ;屏幕右移
MOV A,#1CH
LCALL LCD_XIEMINGLING
MOV A,#1CH
LCALL LCD_XIEMINGLING
MOV A,#1CH
LCALL LCD_XIEMINGLING
RET
JISUANQI_ANJIANDENG_LOOP1:               ;
CJNE A,#3H,JISUANQI_ANJIANDENG_LOOP2     ;+-*运算的结果1602显示
LJMP JISUANQI_ANJIANDENG_LOOP4
JISUANQI_ANJIANDENG_LOOP2:
CJNE A,#2H,JISUANQI_ANJIANDENG_LOOP3     ;
LJMP JISUANQI_ANJIANDENG_LOOP4
JISUANQI_ANJIANDENG_LOOP3:
CJNE A,#1H,JISUANQI_ANJIANDENG_LOOP0     ;
JISUANQI_ANJIANDENG_LOOP4:
MOV A,JISUANQI_JIEGUO1
ANL A,#0F0H
JZ JISUANQI_ANJIANDENG_LOOP1_1     ;判断十位是否为零
SWAP A
ADD A,#30H
LCALL LCD_XIESHUJU
JISUANQI_ANJIANDENG_LOOP1_1:     ;
MOV A,JISUANQI_JIEGUO1     ;
ANL A,#0FH
ADD A,#30H
LCALL LCD_XIESHUJU
INC JIANSHUXU
MOV A,#1CH
LCALL LCD_XIEMINGLING
MOV A,#1CH
LCALL LCD_XIEMINGLING
MOV A,#1CH
LCALL LCD_XIEMINGLING
JISUANQI_ANJIANDENG_LOOP0:
RET

JISUANQI_JIEGUO:
MOV A,JISUANQI_YUNSUAN     ;判断是何种运算
CJNE A,#1H,JISUANQI_JIEGUO_JIAN     ;加运算
MOV A,JISUANQI_DATA1
CLR C
ADD A,JISUANQI_DATA2
DA A
MOV JISUANQI_JIEGUO1,A
RET
JISUANQI_JIEGUO_JIAN:
CJNE A,#2H,JISUANQI_JIEGUO_CHENG     ;减运算
MOV A,JISUANQI_DATA1
CLR C
SUBB A,JISUANQI_DATA2           ;DATA1减去data2
JC JISUANQI_JIEGUO_JIAN_LOOP0     ;判断data1 和data2的大小
MOV JISUANQI_JIEGUO1,A
RET
JISUANQI_JIEGUO_JIAN_LOOP0:     ;是负数，用data2减去data1
MOV A,JISUANQI_DATA2
CLR C
SUBB A,JISUANQI_DATA1
MOV JISUANQI_JIEGUO1,A     ;
MOV A,#0BH
MOVC A,@A+DPTR       ;写负号
LCALL LCD_XIESHUJU
MOV A,#1CH
LCALL LCD_XIEMINGLING     ;
RET
JISUANQI_JIEGUO_CHENG:
CJNE A,#3H,JISUANQI_JIEGUO_CHU     ;乘运算
MOV A,JISUANQI_DATA1
MOV B,JISUANQI_DATA2
CLR C
MUL AB
MOV B,#10
DIV AB
SWAP A
ADD A,B
MOV JISUANQI_JIEGUO1,A
RET
JISUANQI_JIEGUO_CHU:     ;
CJNE A,#4H,JISUANQI_JIEGUO_JIESHU     ;除运算
MOV A,JISUANQI_DATA1
MOV B,JISUANQI_DATA2
DIV AB
MOV JISUANQI_JIEGUO1,A
MOV A,B
CJNE A,#00H,JISUANQI_JIEGUO_CHU_LOOP0     ;判断余数是否为零
MOV JISUANQI_JIEGUO2,#00H
RET
JISUANQI_JIEGUO_CHU_LOOP0:     ;余数不为0计算小数点后一位
MOV B,#0AH
MUL AB
MOV B,JISUANQI_DATA2
DIV AB
SWAP A
MOV JISUANQI_JIEGUO2,A
MOV A,B
CJNE A,#00H,JISUANQI_JIEGUO_CHU_LOOP1
RET
JISUANQI_JIEGUO_CHU_LOOP1:     ;余数不为0计算小数点后第二位
MOV B,#0AH
MUL AB
MOV B,JISUANQI_DATA2
DIV AB
ADD A,JISUANQI_JIEGUO2
MOV JISUANQI_JIEGUO2,A     ;
JISUANQI_JIEGUO_JIESHU:
RET


JIANPAN_PANDUAN:  ;用到累加器A R3和R4
SETB JIANPAN1
SETB JIANPAN2
MOV A,#00H
LCALL HC164_XIERU ;HC164写入数据子程序，用到寄存器R4
JNB JIANPAN1,JIANPAN_PANDUAN_LOOP0
JNB JIANPAN2,JIANPAN_PANDUAN_LOOP1
JB EXIT_BIAOZHI,JIANPAN_PANDUAN_JIESHU_LOOP0
SJMP JIANPAN_PANDUAN
JIANPAN_PANDUAN_JIESHU_LOOP0:
LJMP JIANPAN_PANDUAN_JIESHU
JIANPAN_PANDUAN_LOOP0:
LCALL DELAY10MS
JB JIANPAN1,JIANPAN_PANDUAN
MOV R4,#0H
MOV R3,#08H
SETB HC164_DATA
JIANPAN_PANDUAN_JIAN1:
CLR HC164_CLK
NOP
NOP
SETB HC164_CLK
NOP
NOP
CLR HC164_CLK
JB JIANPAN1,JIANPAN_PANDUAN_JIAN2
INC R4
DJNZ R3,JIANPAN_PANDUAN_JIAN1
JIANPAN_PANDUAN_JIAN2:
MOV A,#00H
LCALL HC164_XIERU
CJNE R4,#00H,JIANPAN_PANDUAN_JIAN_LOOP1
MOV R4,#05H
LJMP JIANPAN_PANDUAN_JIAN_LOOP0
JIANPAN_PANDUAN_JIAN_LOOP1:
CJNE R4,#01H,JIANPAN_PANDUAN_JIAN_LOOP2
MOV R4,#01H
LJMP JIANPAN_PANDUAN_JIAN_LOOP0
JIANPAN_PANDUAN_JIAN_LOOP2:
CJNE R4,#02H,JIANPAN_PANDUAN_JIAN_LOOP3
MOV R4,#04H
LJMP JIANPAN_PANDUAN_JIAN_LOOP0
JIANPAN_PANDUAN_JIAN_LOOP3:
CJNE R4,#03H,JIANPAN_PANDUAN_JIAN_LOOP4
MOV R4,#0H
LJMP JIANPAN_PANDUAN_JIAN_LOOP0
JIANPAN_PANDUAN_JIAN_LOOP4:
CJNE R4,#04H,JIANPAN_PANDUAN_JIAN_LOOP5
MOV R4,#07H
LJMP JIANPAN_PANDUAN_JIAN_LOOP0
JIANPAN_PANDUAN_JIAN_LOOP5:
CJNE R4,#05H,JIANPAN_PANDUAN_JIAN_LOOP6
MOV R4,#03H
LJMP JIANPAN_PANDUAN_JIAN_LOOP0
JIANPAN_PANDUAN_JIAN_LOOP6:
CJNE R4,#06H,JIANPAN_PANDUAN_JIAN_LOOP7
MOV R4,#06H
LJMP JIANPAN_PANDUAN_JIAN_LOOP0
JIANPAN_PANDUAN_JIAN_LOOP7:
CJNE R4,#07H,JIANPAN_PANDUAN_JIESHU
MOV R4,#02H
JIANPAN_PANDUAN_JIAN_LOOP0:
MOV A,R4
RET
JIANPAN_PANDUAN_LOOP1:
LCALL DELAY10MS
JB JIANPAN2,JIANPAN_PANDUAN
MOV R4,#08H
MOV R3,#08H
SETB HC164_DATA
JIANPAN_PANDUAN_JIAN8:
CLR HC164_CLK
NOP
NOP
SETB HC164_CLK
NOP
NOP
CLR HC164_CLK
JB JIANPAN2,JIANPAN_PANDUAN_JIAN9
INC R4
DJNZ R3,JIANPAN_PANDUAN_JIAN8
JIANPAN_PANDUAN_JIAN9:
MOV A,#00H
LCALL HC164_XIERU
CJNE R4,#08H,JIANPAN_PANDUAN_JIAN_LOOP9
MOV R4,#0DH
LJMP JIANPAN_PANDUAN_JIAN_LOOP16
JIANPAN_PANDUAN_JIAN_LOOP9:
CJNE R4,#09H,JIANPAN_PANDUAN_JIAN_LOOP10
MOV R4,#09H
LJMP JIANPAN_PANDUAN_JIAN_LOOP16
JIANPAN_PANDUAN_JIAN_LOOP10:
CJNE R4,#0AH,JIANPAN_PANDUAN_JIAN_LOOP11
MOV R4,#0CH
LJMP JIANPAN_PANDUAN_JIAN_LOOP16
JIANPAN_PANDUAN_JIAN_LOOP11:
CJNE R4,#0BH,JIANPAN_PANDUAN_JIAN_LOOP12
MOV R4,#08H
LJMP JIANPAN_PANDUAN_JIAN_LOOP16
JIANPAN_PANDUAN_JIAN_LOOP12:
CJNE R4,#0CH,JIANPAN_PANDUAN_JIAN_LOOP13
MOV R4,#0FH
LJMP JIANPAN_PANDUAN_JIAN_LOOP16
JIANPAN_PANDUAN_JIAN_LOOP13:
CJNE R4,#0DH,JIANPAN_PANDUAN_JIAN_LOOP14
MOV R4,#0BH
LJMP JIANPAN_PANDUAN_JIAN_LOOP16
JIANPAN_PANDUAN_JIAN_LOOP14:
CJNE R4,#0EH,JIANPAN_PANDUAN_JIAN_LOOP15
MOV R4,#0EH
LJMP JIANPAN_PANDUAN_JIAN_LOOP16
JIANPAN_PANDUAN_JIAN_LOOP15:
CJNE R4,#0FH,JIANPAN_PANDUAN_JIESHU
MOV R4,#0AH
JIANPAN_PANDUAN_JIAN_LOOP16:
MOV A,R4
RET
JIANPAN_PANDUAN_JIESHU:
RET


HC164_XIERU:   ;HC164写入数据子程序用到寄存器R4
PUSH 04H
MOV R4,#8H
HC164_XIERU_LOOP2:
CLR C
RRC A
JC HC164_XIERU_LOOP0
CLR HC164_DATA
SJMP HC164_XIERU_LOOP1
HC164_XIERU_LOOP0:
SETB HC164_DATA
HC164_XIERU_LOOP1:
CLR HC164_CLK
NOP
NOP
SETB HC164_CLK
NOP
NOP
CLR HC164_CLK
DJNZ R4,HC164_XIERU_LOOP2
POP 04H
RET



;数码管时钟用到寄存器R3
SHUMA_SHIZHONG_CHANGAN_JIESHU:
MOV HC595_MIAO,#00H
MOV HC595_FEN,#00H
MOV HC595_SHI,#00H
LCALL SHUMA_XIANSHI
LJMP SHUMA_DINGSHI

SHUMA_SHIZHONG:
LCALL SHUMA_QINGLING
SHUMA_SHIZHONG_LOOP:
CLR UP_BIAOZHI
CLR DOWN_BIAOZHI
CLR OK_BIAOZHI
CLR EXIT_BIAOZHI         ;清除各标志位
CLR OKCHANGAN_BIAOZHI
SHUMA_SHIZHONG_LOOP0:
LCALL SHUMA_XIANSHI      ;数码显示
MOV DINGSHI_JISHU,#30
LCALL DINGSHI_DELAY      ;定时器延时
JBC EXIT_BIAOZHI,SHUMA_SHIZHONG_JIESHU1   ;延时期间若按退出键结束
JBC UP_BIAOZHI,SHUMA_SHIZHONG_LOOP1
JBC DOWN_BIAOZHI,SHUMA_SHIZHONG_LOOP3
JB OK_BIAOZHI,SHUMA_SHIZHONG_LOOP5    ;若有按键按下执行对应操作
JBC OKCHANGAN_BIAOZHI,SHUMA_SHIZHONG_CHANGAN_JIESHU
MOV R3,HC595_MIAO
MOV HC595_MIAO,#0AAH     ;A对应字符00，熄灭数码管
LCALL SHUMA_XIANSHI
MOV HC595_MIAO,R3
MOV DINGSHI_JISHU,#30
LCALL DINGSHI_DELAY
JBC EXIT_BIAOZHI,SHUMA_SHIZHONG_JIESHU1   ;延时期间若按退出键结束
JBC UP_BIAOZHI,SHUMA_SHIZHONG_LOOP1    ;若有按键按下执行对应操作
JBC OKCHANGAN_BIAOZHI,SHUMA_SHIZHONG_CHANGAN_JIESHU
SJMP SHUMA_SHIZHONG_LOOP2
SHUMA_SHIZHONG_JIESHU1:
LJMP SHUMA_SHIZHONG_JIESHU
SHUMA_SHIZHONG_LOOP1:   
CLR C
MOV A,HC595_MIAO
ADD A,#01H
DA A
MOV HC595_MIAO,A
CJNE A,#60H,SHUMA_SHIZHONG_LOOP2
MOV HC595_MIAO,#00H
SHUMA_SHIZHONG_LOOP2: 
JBC DOWN_BIAOZHI,SHUMA_SHIZHONG_LOOP3
SJMP SHUMA_SHIZHONG_LOOP5
SHUMA_SHIZHONG_LOOP3:  ;DOWN键操作
MOV A,HC595_MIAO
JNZ SHUMA_SHIZHONG_LOOP4 ;若为零即为60-1
MOV A,#5AH
SHUMA_SHIZHONG_LOOP4: ;秒的数值减一，
CLR C
SUBB A,#01H
MOV R3,A
ANL A,#0FH
CJNE A,#0FH,SHUMA_SHIZHONG_FUJIA3
CLR C
MOV A,R3
SUBB A,#06H
MOV R3,A  
SHUMA_SHIZHONG_FUJIA3:
CLR C
MOV A,R3
DA A
MOV HC595_MIAO,A
SHUMA_SHIZHONG_LOOP5:
JNB OK_BIAOZHI,SHUMA_SHIZHONG_LOOP0  ;未按下OK建继续循环秒部分
CLR OK_BIAOZHI
SHUMA_SHIZHONG_SHANFEN: ;进入调分 ，原理和秒部分相似
SHUMA_SHIZHONG_LOOP6:
LCALL SHUMA_XIANSHI
MOV DINGSHI_JISHU,#30
LCALL DINGSHI_DELAY
JBC EXIT_BIAOZHI,SHUMA_SHIZHONG_JIESHU2   ;延时期间若按退出键结束
JBC UP_BIAOZHI,SHUMA_SHIZHONG_LOOP7
JBC DOWN_BIAOZHI,SHUMA_SHIZHONG_LOOP9
JB OK_BIAOZHI,SHUMA_SHIZHONG_LOOP11
JBC OKCHANGAN_BIAOZHI,SHUMA_SHIZHONG_CHANGAN_JIESHU1
MOV R3,HC595_FEN
MOV HC595_FEN,#0AAH
LCALL SHUMA_XIANSHI
MOV DINGSHI_JISHU,#30
LCALL DINGSHI_DELAY
JBC EXIT_BIAOZHI,SHUMA_SHIZHONG_JIESHU2   ;延时期间若按退出键结束
MOV HC595_FEN,R3
JBC UP_BIAOZHI,SHUMA_SHIZHONG_LOOP7
JBC OKCHANGAN_BIAOZHI,SHUMA_SHIZHONG_CHANGAN_JIESHU1
SJMP SHUMA_SHIZHONG_LOOP8
SHUMA_SHIZHONG_JIESHU2:
LJMP SHUMA_SHIZHONG_JIESHU
SHUMA_SHIZHONG_CHANGAN_JIESHU1:
LJMP SHUMA_SHIZHONG_CHANGAN_JIESHU
SHUMA_SHIZHONG_LOOP7:
CLR C
MOV A,HC595_FEN
ADD A,#01H
DA A
MOV HC595_FEN,A
CJNE A,#60H,SHUMA_SHIZHONG_LOOP8
MOV HC595_FEN,#00H
SHUMA_SHIZHONG_LOOP8:
JBC DOWN_BIAOZHI,SHUMA_SHIZHONG_LOOP9
SJMP SHUMA_SHIZHONG_LOOP11
SHUMA_SHIZHONG_LOOP9:
MOV A,HC595_FEN
JNZ SHUMA_SHIZHONG_LOOP10
MOV A,#5AH
SHUMA_SHIZHONG_LOOP10:
CLR C
SUBB A,#01H
MOV R3,A
ANL A,#0FH
CJNE A,#0FH,SHUMA_SHIZHONG_FUJIA2
CLR C
MOV A,R3
SUBB A,#06H
MOV R3,A  
SHUMA_SHIZHONG_FUJIA2:
CLR C
MOV A,R3
DA A
MOV HC595_FEN,A
SHUMA_SHIZHONG_LOOP11:
JNB OK_BIAOZHI,SHUMA_SHIZHONG_LOOP6
CLR OK_BIAOZHI
SHUMA_SHIZHONG_SHANSHI:  ;...........进入调时
SHUMA_SHIZHONG_LOOP12:
LCALL SHUMA_XIANSHI
MOV DINGSHI_JISHU,#30
LCALL DINGSHI_DELAY
JBC EXIT_BIAOZHI,SHUMA_SHIZHONG_JIESHU   ;延时期间若按退出键结束
JBC UP_BIAOZHI,SHUMA_SHIZHONG_LOOP13
JBC DOWN_BIAOZHI,SHUMA_SHIZHONG_LOOP15
JB OK_BIAOZHI,SHUMA_SHIZHONG_LOOP17
JBC OKCHANGAN_BIAOZHI,SHUMA_SHIZHONG_CHANGAN_JIESHU2
MOV R3,HC595_SHI
MOV HC595_SHI,#0AAH
LCALL SHUMA_XIANSHI
MOV DINGSHI_JISHU,#30
LCALL DINGSHI_DELAY
JBC EXIT_BIAOZHI,SHUMA_SHIZHONG_JIESHU   ;延时期间若按退出键结束
MOV HC595_SHI,R3
JBC UP_BIAOZHI,SHUMA_SHIZHONG_LOOP13
JBC OKCHANGAN_BIAOZHI,SHUMA_SHIZHONG_CHANGAN_JIESHU2
SJMP SHUMA_SHIZHONG_LOOP14
SHUMA_SHIZHONG_LOOP13:
CLR C
MOV A,HC595_SHI
ADD A,#01H
DA A
MOV HC595_SHI,A
CJNE A,#24H,SHUMA_SHIZHONG_LOOP14
MOV HC595_SHI,#00H
SHUMA_SHIZHONG_LOOP14:
JBC DOWN_BIAOZHI,SHUMA_SHIZHONG_LOOP15
SJMP SHUMA_SHIZHONG_LOOP17
SHUMA_SHIZHONG_CHANGAN_JIESHU2:
LJMP SHUMA_SHIZHONG_CHANGAN_JIESHU
SHUMA_SHIZHONG_LOOP15:
CLR C
MOV A,HC595_SHI
JNZ SHUMA_SHIZHONG_LOOP16
MOV A,#24H
SHUMA_SHIZHONG_LOOP16:
SUBB A,#01H
MOV R3,A
ANL A,#0FH
CJNE A,#0FH,SHUMA_SHIZHONG_FUJIA1
CLR C
MOV A,R3
SUBB A,#06H
MOV R3,A  
SHUMA_SHIZHONG_FUJIA1:
CLR C
MOV A,R3
DA A
MOV HC595_SHI,A
SHUMA_SHIZHONG_LOOP17:
JNB OK_BIAOZHI,SHUMA_SHIZHONG_LOOP12
CLR OK_BIAOZHI
SHUMA_SHIZHONG_YUNXING:;时钟正常运行
LCALL SHUMA_XIANSHI
MOV DINGSHI_JISHU,#50  ;
LCALL DINGSHI_DELAY
JBC EXIT_BIAOZHI,SHUMA_SHIZHONG_JIESHU   ;延时期间若按退出键结束
JBC OK_BIAOZHI,SHUMA_SHIZHONG_LOOP0_1   ;OK键进入调时间
JBC OKCHANGAN_BIAOZHI,SHUMA_SHIZHONG_CHANGAN_JIESHU2
LCALL SHUMA_JIAYI
LJMP SHUMA_SHIZHONG_YUNXING
SHUMA_SHIZHONG_LOOP0_1:
LJMP SHUMA_SHIZHONG_LOOP
SHUMA_SHIZHONG_JIESHU:
MOV HC595_MIAO,#00H
MOV HC595_FEN,#00H
MOV HC595_SHI,#00H
LCALL SHUMA_XIANSHI
RET
;数码管加一

SHUMA_JIAYI:
MOV A,HC595_MIAO   ;秒加一
CLR C
ADD A,#01H
DA A
MOV HC595_MIAO,A   ;
CJNE A,#60H,SHUMA_JIAYI_JIESHU ;若等于60分加一
MOV HC595_MIAO,#0H   ;秒变0
MOV A,HC595_FEN   ;
CLR C
ADD A,#01H  ;分加一
DA A
MOV HC595_FEN,A
CJNE A,#60H,SHUMA_JIAYI_JIESHU ;分等于60时加一
MOV HC595_FEN,#0H   ;分变0
MOV A,HC595_SHI   ;
CLR C
ADD A,#01H ;时加一
DA A   ;
MOV HC595_SHI,A   ;
CJNE A,#24H,SHUMA_JIAYI_JIESHU  ;时等于60清零
MOV HC595_SHI,#0H   ;
SHUMA_JIAYI_JIESHU:
RET

;数码管只显示
SHUMA_XIANSHI:
PUSH 03H
MOV R4,#6H         ;表示6位数
MOV A,HC595_MIAO   ;取秒
MOV R5,A           ;暂存到R5
ANL A,#0FH       ;取秒的个位
SHUMA_XIANSHI_LOOP1:
MOV DPTR,#BIAO_SHUZI   ;取表123456789的数码管字符地址
MOVC A,@A+DPTR         ; 把取到的字符放到A  
MOV R3,#8H   ;每位数移8位
SHUMA_MIAOSHAN_LOOP2:   ;
RRC A   ;向右移位
JNC SHUMA_XIANSHI_LOOP3   ;C没有置一跳转
CLR HC595_DATA   ;C为0，清零date位
SJMP SHUMA_XIANSHI_LOOP0   ;
SHUMA_XIANSHI_LOOP3:
SETB HC595_DATA   ;置一data位
SHUMA_XIANSHI_LOOP0:
CLR HC595_SHCP   ;595读入一位数据
NOP
SETB HC595_SHCP
DJNZ R3,SHUMA_MIAOSHAN_LOOP2   ;读入一位数据循环
DJNZ R4,SHUMA_XIANSHI_LOOP4   ;读入6位数据后刷新显示
CLR HC595_SLCP
NOP
SETB HC595_SLCP   ;
SHUMA_XIANSHI_LOOP4:
CJNE R4,#5H,SHUMA_XIANSHI_LOOP5  ;R4为5则秒的个位读入完毕，该十位
MOV A,R5
ANL A,#0F0H
SWAP A
LJMP SHUMA_XIANSHI_LOOP1   ;跳转到移位部分
SHUMA_XIANSHI_LOOP5:
CJNE R4,#4H,SHUMA_XIANSHI_LOOP6   ;R4为5则秒的十位读入完毕，该分个位
MOV A,HC595_FEN
MOV R5,A
ANL A,#0FH
LJMP SHUMA_XIANSHI_LOOP1   ;跳转到移位部分
SHUMA_XIANSHI_LOOP6:
CJNE R4,#3H,SHUMA_XIANSHI_LOOP7  ;R4为5则分的个位读入完毕，该分十位
MOV A,R5
ANL A,#0F0H
SWAP A
LJMP SHUMA_XIANSHI_LOOP1   ;继续移位
SHUMA_XIANSHI_LOOP7:
CJNE R4,#2H,SHUMA_XIANSHI_LOOP8   ;R4为5则分的十位读入完毕，该时个位
MOV A,HC595_SHI
MOV R5,A
ANL A,#0FH
LJMP SHUMA_XIANSHI_LOOP1   ;
SHUMA_XIANSHI_LOOP8:
CJNE R4,#1H,SHUMA_XIANSHI_JIESHU   ;R4为5则时的个位读入完毕，该时十位
MOV A,R5   ;
ANL A,#0F0H   ;
SWAP A   ;
LJMP SHUMA_XIANSHI_LOOP1      ;
SHUMA_XIANSHI_JIESHU:
POP 03H
RET
;数码管595秒表


SHUMA_DINGSHI:
CLR UP_BIAOZHI
CLR DOWN_BIAOZHI
CLR OK_BIAOZHI
CLR EXIT_BIAOZHI
CLR OKCHANGAN_BIAOZHI
LCALL SHUMA_QINGLING     ;给数码管清零
LJMP SHUMA_OK        ;先暂停
SHUMA_TOU:
LCALL DINGSHI_DELAY     ;用定时器延时;是更精确改
;...................
LCALL SHUMA_XIANSHI
SHUMA_LOOP7:          ;时的十位读入完毕则
MOV DINGSHI_JISHU,#1   ;延时
;LCALL DINGSHI_DELAY     ;用定时器延时
JBC EXIT_BIAOZHI,SHUMA_JIESHU   ;延时期间若按退出键结束
SHUMA_LOOP11:
JB OK_BIAOZHI,SHUMA_OK  ;若按下OK键，跳转到其操作
JB OKCHANGAN_BIAOZHI,SHUMA_LOOP17
LJMP SHUMA_OK_JIESHU  ;未按下跳过ok按键操作
SHUMA_OK:
CLR OK_BIAOZHI
JBC UP_BIAOZHI,SHUMA_OK_JIESHU;查询up键和down键是否被按下
JBC DOWN_BIAOZHI,SHUMA_OK_DOWN;按下up继续计数，down清零
JBC EXIT_BIAOZHI,SHUMA_JIESHU   ;若按退出键结束
JB OKCHANGAN_BIAOZHI,SHUMA_LOOP17
AJMP SHUMA_OK;
SHUMA_OK_DOWN:
MOV HC595_MIAO,#00H
MOV HC595_FEN,#00H;
MOV HC595_SHI,#00H
LCALL SHUMA_QINGLING;按键down清零
AJMP SHUMA_OK
SHUMA_OK_JIESHU:
JNB DOWN_BIAOZHI,SHUMA_LOOP12;down按键直接清零，并暂停
CLR DOWN_BIAOZHI;
MOV HC595_MIAO,#00H
MOV HC595_FEN,#00H
MOV HC595_SHI,#00H
LCALL SHUMA_QINGLING;
LJMP SHUMA_OK;
SHUMA_LOOP12:
MOV A,HC595_MIAO   ;秒加一
CLR C
ADD A,#01H
DA A
MOV HC595_MIAO,A   ;
CJNE A,#00H,SHUMA_LOOP14  ;若等于60分加一
SJMP SHUMA_LOOP13   ;添加loop9的原因是跳转超出了范围
SHUMA_LOOP14:
LJMP SHUMA_TOU
SHUMA_LOOP13:
MOV HC595_MIAO,#0H   ;秒变0
MOV A,HC595_FEN   ;
CLR C
ADD A,#01H  ;分加一
DA A
MOV HC595_FEN,A
CJNE A,#60H,SHUMA_LOOP15   ;分等于60时加一
SJMP SHUMA_LOOP16   ;添加loop9的原因是跳转超出了范围
SHUMA_LOOP15:
LJMP SHUMA_TOU
SHUMA_LOOP16:
MOV HC595_FEN,#0H   ;分变0
MOV A,HC595_SHI   ;
CLR C
ADD A,#01H ;时加一
DA A   ;
MOV HC595_SHI,A   ;
CJNE A,#60H,SHUMA_LOOP9   ;时等于60清零
SJMP SHUMA_LOOP10   ;添加loop9的原因是跳转超出了范围
SHUMA_LOOP9:
LJMP SHUMA_TOU
SHUMA_LOOP10:
MOV HC595_SHI,#0H   ;
LJMP SHUMA_TOU   ;
SHUMA_JIESHU:
MOV HC595_MIAO,#00H
MOV HC595_FEN,#00H
MOV HC595_SHI,#00H
LCALL SHUMA_XIANSHI ;清零
RET
SHUMA_LOOP17:
MOV HC595_MIAO,#00H
MOV HC595_FEN,#00H
MOV HC595_SHI,#00H
LCALL SHUMA_XIANSHI ;清零
LJMP SHUMA_SHIZHONG
RET

SHUMA_QINGLING:
MOV R3,#6H       ;表示6位数
MOV R4,#8        ;移八位
MOV A,#0H        ;取0
MOV DPTR,#BIAO_SHUZI    ;取0的字符
MOVC A,@A+DPTR          ;把取到的字符放到A  
SHUMA_QINGLING_LOOP1:   ;
RRC A   ;向右移位
JNC SHUMA_QINGLING_ZHIYIDATA  ;C没有置一跳转
CLR HC595_DATA   ;C为0，清零date位
SJMP SHUMA_QINGLING_LOOP0   ;
SHUMA_QINGLING_ZHIYIDATA:
SETB HC595_DATA   ;【C为一，置一data位
SHUMA_QINGLING_LOOP0:
CLR HC595_SHCP   ;595读入一位数据
NOP
SETB HC595_SHCP
DJNZ R4,SHUMA_QINGLING_LOOP1
RRC A
MOV R4,#8  
DJNZ R3,SHUMA_QINGLING_LOOP1
CLR HC595_SLCP
NOP
SETB HC595_SLCP   ;
RET
				
				
;定时器部分
T1DINGSHI:
MOV TH1,#0D8H   ;十毫秒
MOV TL1,#0F0H
PUSH ACC
MOV A,HONGWAIZ_MA
CJNE A,#04H,T1DINGSHI_EXIT
CLR TR1   ;停止定时器计数
LJMP T1DINGSHI_EXIT_J
T1DINGSHI_EXIT:
JB KEY_EXIT,T1DINGSHI_LOOP0    ;判断退出按键是否按下
CLR TR1   ;停止定时器计数
LCALL DELAY10MS
JB KEY_EXIT,T1DINGSHI_LOOP0     ;
JNB KEY_EXIT,$     ;
T1DINGSHI_EXIT_J:
SETB EXIT_BIAOZHI     ;按下后退出标志位置一
LCALL ANJIAN_EXIT     ;执行退出
MOV HONGWAIZ_MA,#00H
MOV DINGSHI_JISHU,#00H     ;定时计数赋零
POP ACC
SETB TR1     ;
RETI
T1DINGSHI_LOOP0:
MOV A,LCD_CAIDAN_YE
CJNE A,#7H,T1DINGSHI_LOOP1_1;
MOV A,HONGWAIZ_MA
CJNE A,#00H,DINGSHI_HONGWAI
LJMP DINGSHI_UP
T1DINGSHI_LOOP1_1:
LJMP T1DINGSHI_LOOP1
DINGSHI_HONGWAI:
CJNE A,#01H,DINGSHI_HONGWAIZ_J2
CLR TR1   ;停止定时器计数
LJMP DINGSHI_UP_J
DINGSHI_HONGWAIZ_J2:
CJNE A,#02H,DINGSHI_HONGWAIZ_J3
CLR TR1   ;停止定时器计数
LJMP DINGSHI_DOWN_J
DINGSHI_HONGWAIZ_J3:
CJNE A,#03H,T1DINGSHI_LOOP1
CLR TR1   ;停止定时器计数
LJMP DINGSHI_OK_J
DINGSHI_UP:
JB KEY_UP,DINGSHI_DOWN;
CLR TR1   ;停止定时器计数
LCALL DELAY10MS
JB KEY_UP,DINGSHI_DOWN;
JNB KEY_UP,$
DINGSHI_UP_J:
SETB UP_BIAOZHI;
LCALL FENGMING
MOV HONGWAIZ_MA,#00H
MOV DINGSHI_JISHU,#00H     ;定时计数赋零
POP ACC     ;
SETB TR1     ;
RETI
DINGSHI_DOWN:
JB KEY_DOWN,DINGSHI_OK;
CLR TR1   ;停止定时器计数
LCALL DELAY10MS
JB KEY_DOWN,DINGSHI_OK;
JNB KEY_DOWN,$
DINGSHI_DOWN_J:
SETB DOWN_BIAOZHI;
LCALL FENGMING
MOV HONGWAIZ_MA,#00H
MOV DINGSHI_JISHU,#00H     ;定时计数赋零
POP ACC     ;
SETB TR1     ;
RETI
DINGSHI_OK:
JB KEY_OK,T1DINGSHI_LOOP1;
CLR TR1   ;停止定时器计数
MOV ANJIAN_CHANGAN,#150
SETB TR0
LCALL DELAY10MS
JB KEY_OK,T1DINGSHI_LOOP1  ;
JNB KEY_OK,$
MOV A,ANJIAN_CHANGAN
CJNE A,#0H,T1DINGSHI_LOOP3
SETB OKCHANGAN_BIAOZHI
SJMP T1DINGSHI_LOOP4
T1DINGSHI_LOOP3:
DINGSHI_OK_J:
SETB OK_BIAOZHI;
MOV ANJIAN_CHANGAN,#0H
T1DINGSHI_LOOP4:
LCALL FENGMING
MOV HONGWAIZ_MA,#00H
MOV DINGSHI_JISHU,#00H     ;定时计数赋零
POP ACC     ;
SETB TR1     ;
RETI
T1DINGSHI_LOOP1:
MOV A,DINGSHI_JISHU     ;
CJNE A,#00H,T1DINGSHI_LOOP2     ;判断定时计数是否为0不为零则减一
POP ACC     ;
SETB TR1     ;
RETI
T1DINGSHI_LOOP2:
DEC DINGSHI_JISHU     ;
POP ACC
SETB TR1     ;
RETI
;......定时器延时
DINGSHI_DELAY:
PUSH ACC     ;
DINGSHI_LOOP0:
MOV A,DINGSHI_JISHU     ;等待定时计数为0
CJNE A,#0H,DINGSHI_LOOP0     ;
POP ACC
RET
;LED灯部分
LEDDIYI:
MOV R4,#20H
MOV R3,#40H
MOV LEDYANSHI_JISHU,R3
MOV A,#0FEH
CLR EXIT_BIAOZHI   ;清零退出标志位
LEDDIYI_LOOP0:
SETB C
MOV LED,A     ;
RLC A
CJNE A,#0FFH,LEDDIYI_LOOP1
MOV A,#0FEH
LEDDIYI_LOOP1:
LCALL DELAY300US
JBC EXIT_BIAOZHI,LEDDIYI_JIESHU     ;按退出键则结束
DJNZ R3,LEDDIYI_LOOP1
MOV R3,LEDYANSHI_JISHU
LEDDIYI_LOOP2:
DJNZ R4,LEDDIYI_LOOP0     ;
MOV R4,#20H
DEC LEDYANSHI_JISHU
MOV R3,LEDYANSHI_JISHU
CJNE R3,#0H,LEDDIYI_LOOP0
MOV LEDYANSHI_JISHU,#40H
MOV R3,LEDYANSHI_JISHU
SJMP LEDDIYI_LOOP0
LEDDIYI_JIESHU:
MOV LED,#0FFH
RET

LEDDIER:
CLR EXIT_BIAOZHI
MOV DPTR,#BIAO_LEDDIER_XIANSHI
MOV R3,#9H
LEDDIER_LOOP0:
MOV A,#00H
MOVC A,@A+DPTR
MOV LED,A
INC DPTR
MOV DINGSHI_JISHU,#100
LCALL DINGSHI_DELAY
JBC EXIT_BIAOZHI,LEDDIER_JIESHU
DJNZ R3,LEDDIER_LOOP0
LJMP LEDDIER
LEDDIER_JIESHU:
MOV LED,#0FFH
RET
BIAO_LEDDIER_XIANSHI:
DB 18H,24H,42H,81H,0C3H,0E7H,0FFH,7EH,3CH
LEDDISAN:
CLR EXIT_BIAOZHI
MOV DPTR,#BIAO_LEDDISAN_XIANSHI
MOV R3,#9H
LEDDISAN_LOOP0:
MOV A,#00H
MOVC A,@A+DPTR
MOV LED,A
INC DPTR
MOV DINGSHI_JISHU,#100
LCALL DINGSHI_DELAY
JBC EXIT_BIAOZHI,LEDDISAN_JIESHU
DJNZ R3,LEDDISAN_LOOP0
LJMP LEDDISAN
LEDDISAN_JIESHU:
MOV LED,#0FFH
RET
BIAO_LEDDISAN_XIANSHI:
DB 0E7H,0DBH,0BDH,7EH,03CH,018H,00H,81H,0C3H
	
LEDDISI:
CLR EXIT_BIAOZHI
MOV DPTR,#BIAO_LEDDISI_XIANSHI
MOV R3,#9H
LEDDISI_LOOP0:
MOV A,#00H
MOVC A,@A+DPTR
MOV LED,A
INC DPTR
MOV DINGSHI_JISHU,#100
LCALL DINGSHI_DELAY
JBC EXIT_BIAOZHI,LEDDISI_JIESHU
DJNZ R3,LEDDISI_LOOP0
LJMP LEDDISI
LEDDISI_JIESHU:
MOV LED,#0FFH
RET
BIAO_LEDDISI_XIANSHI:
DB 0F0H,0FH,00H,81H,0AAH,055H,0AAH,55H,0AAH
;1602部分

;..............LCD1602显示
			 LCD_XIANSHI:
             LCALL LCD_CHUSHIHUA    ;初始化
			 MOV DPTR,#BIAO_LCD_HUANYING1     ;欢迎界面
		     LCALL LCD_DIYIHANG_DELAY
			 MOV DPTR,#BIAO_LCD_HUANYING2     ;
			 LCALL LCD_DIERHANG_DELAY
			 RET
;............按键操作
ANJIAN_UP:
LCALL FENGMING
MOV A,LCD_CAIDAN_YE
CJNE A,#00H,ANJIAN_UP_CAIDAN_YE1     ;初始时页为零
MOV DPTR,#BIAO_LCD_LED     ;
LCALL LCD_DIYIHANG_BIAOJI     ;显示菜单一
LCALL LCD_DIERHANG
INC LCD_CAIDAN ;菜单赋值一
MOV LCD_CAIDAN_YE,#1H     ;页值赋为一
LJMP ANJIAN_UP_JIESHU;结束

ANJIAN_UP_CAIDAN_YE1:   
DEC LCD_CAIDAN    ;菜单值减一
MOV A,LCD_CAIDAN_YE     ;
CJNE A,#1,ANJIAN_UP_CAIDAN_YE2     ;;若为菜单一
;........
MOV A,LCD_CAIDAN  
CJNE A,#0H,ANJIAN_UP_CAIDAN1234     ;若为123则跳转
MOV DPTR,#BIAO_LCD_HONGWAI     ;若菜单值为0，则实际为四
LCALL LCD_DIYIHANG_BIAOJI     ;
MOV DPTR,#BIAO_LCD_LED     ;
LCALL LCD_DIERHANG
MOV LCD_CAIDAN,#4H     ;
RET
ANJIAN_UP_CAIDAN1234:   ;
MOV DPTR,#BIAO_LCD_LED     ;页一的表头地址
MOV A,LCD_CAIDAN     ;菜单值减一乘16就是对应菜单的表头
DEC A
MOV B,#16     ;
MUL AB
CLR C
ADD A,DPL     ;
MOV DPL,A     ;
MOV A,DPH
ADDC A,#00H     ;
MOV DPH,A     ;
LCALL LCD_DIYIHANG_BIAOJI
LCALL LCD_DIERHANG
RET
ANJIAN_UP_CAIDAN_YE2:    ;
CJNE A,#2,ANJIAN_UP_CAIDAN_YE3    ;若为菜单页二
;......
MOV A,LCD_CAIDAN
CJNE A,#4H,ANJIAN_UP_CAIDAN5678    ;若为567跳转
MOV DPTR,#BIAO_LCD_LED4    ;若为菜单4实际是8
LCALL LCD_DIYIHANG_BIAOJI
MOV DPTR,#BIAO_LCD_LED1    ;
LCALL LCD_DIERHANG    ;
MOV LCD_CAIDAN,#8H
RET
ANJIAN_UP_CAIDAN5678:
MOV DPTR,#BIAO_LCD_LED1    ;
MOV A,LCD_CAIDAN    ;
CLR C
SUBB A,#5H    ;菜单值减5乘16就是对应菜单的表头
MOV B,#16
MUL AB
CLR C
ADD A,DPL
MOV DPL,A
MOV A,DPH
ADDC A,#00H    ;
MOV DPH,A
LCALL LCD_DIYIHANG_BIAOJI    ;
LCALL LCD_DIERHANG
RET
ANJIAN_UP_CAIDAN_YE3:     ;
MOV A,LCD_CAIDAN_YE    ;
CJNE A,#3,ANJIAN_UP_CAIDAN_YE4    ;若为菜单页4
;.......
MOV A,LCD_CAIDAN                ;
CJNE A,#9H,ANJIAN_UP_CAIDANA    ;菜单9显示
MOV DPTR,#BIAO_LCD_TIME_JISHU   ;
LCALL LCD_DIYIHANG_BIAOJI
MOV DPTR,#BIAO_LCD_TIME_SHIZHONG    ;
LCALL LCD_DIERHANG
RET
ANJIAN_UP_CAIDANA:
CJNE A,#8H,ANJIAN_UP_JIESHU    ;菜单10显示
MOV DPTR,#BIAO_LCD_TIME_SHIZHONG    ;
LCALL LCD_DIYIHANG_BIAOJI
MOV DPTR,#BIAO_LCD_TIME_JISHU    ;
LCALL LCD_DIERHANG
MOV LCD_CAIDAN,#0AH    ;
RET
ANJIAN_UP_CAIDAN_YE4:     ;
MOV A,LCD_CAIDAN_YE
CJNE A,#4,ANJIAN_UP_CAIDAN_YE5    ;
;.....
ANJIAN_UP_CAIDANB:
MOV A,LCD_CAIDAN
CJNE A,#0AH,ANJIAN_UP_JIESHU    ;菜单11显示
MOV DPTR,#BIAO_LCD_JISUANQI_QUEDING    ;
LCALL LCD_DIYIHANG
LCALL LCD_DIERHANG
MOV LCD_CAIDAN,#0BH    ;
RET
ANJIAN_UP_CAIDAN_YE5:      ;
MOV A,LCD_CAIDAN_YE
CJNE A,#5,ANJIAN_UP_JIESHU    ;页5菜单12显示
;......
ANJIAN_UP_CAIDANC:
MOV A,LCD_CAIDAN    ;
CJNE A,#0BH,ANJIAN_UP_JIESHU    ;
MOV DPTR,#BIAO_LCD_HONGWAI_QUEDING    ;
LCALL LCD_DIYIHANG
LCALL LCD_DIERHANG
MOV LCD_CAIDAN,#0CH    ;
RET
ANJIAN_UP_JIESHU:
RET

;.......
ANJIAN_DOWN:
LCALL FENGMING
MOV A,LCD_CAIDAN_YE    ;
CJNE A,#00H,ANJIAN_DOWN_CAIDAN_YE1    ;与up键类似
MOV DPTR,#BIAO_LCD_LED    ;
LCALL LCD_DIYIHANG_BIAOJI
MOV DPTR,#BIAO_LCD_TIME
LCALL LCD_DIERHANG
INC LCD_CAIDAN
MOV LCD_CAIDAN_YE,#1H
LJMP ANJIAN_DOWN_JIESHU    ;
ANJIAN_DOWN_CAIDAN_YE1:    ;
INC LCD_CAIDAN    ;
MOV A,LCD_CAIDAN_YE    ;
CJNE A,#1H,ANJIAN_DOWN_CAIDAN_YE2    ;
MOV A,LCD_CAIDAN    ;
CJNE A,#4H,ANJIAN_DOWN_CAIDAN1234    ;
MOV DPTR,#BIAO_LCD_HONGWAI    ;
LCALL LCD_DIYIHANG_BIAOJI    ;
MOV DPTR,#BIAO_LCD_LED    ;
LCALL LCD_DIERHANG    ;
RET
ANJIAN_DOWN_CAIDAN1234:    ;
MOV DPTR,#BIAO_LCD_LED    ;
MOV A,LCD_CAIDAN    ;
CJNE A,#5H,ANJIAN_DOWN_CAIDAN1234_LOOP0    ;
MOV A,#1H
MOV LCD_CAIDAN,A    ;
ANJIAN_DOWN_CAIDAN1234_LOOP0:
DEC A
MOV B,#16    ;
MUL AB
CLR C
ADD A,DPL    ;
MOV DPL,A    ;
MOV A,DPH    ;
ADDC A,#00H    ;
MOV DPH,A
LCALL LCD_DIYIHANG_BIAOJI
LCALL LCD_DIERHANG
RET
ANJIAN_DOWN_CAIDAN_YE2:    ;
CJNE A,#2H,ANJIAN_DOWN_CAIDAN_YE3    ;
;......
MOV A,LCD_CAIDAN
CJNE A,#8H,ANJIAN_DOWN_CAIDAN5678    ;
MOV DPTR,#BIAO_LCD_LED4    ;
LCALL LCD_DIYIHANG_BIAOJI    ;
MOV DPTR,#BIAO_LCD_LED1    ;
LCALL LCD_DIERHANG
RET
ANJIAN_DOWN_CAIDAN5678:
MOV DPTR,#BIAO_LCD_LED1    ;
MOV A,LCD_CAIDAN    ;
CJNE A,#9H,ANJIAN_DOWN_CAIDAN5678_LOOP0    ;
MOV A,#5H    ;
MOV LCD_CAIDAN,A    ;
ANJIAN_DOWN_CAIDAN5678_LOOP0:
CLR C
SUBB A,#5H    ;
MOV B,#10H    ;
MUL AB    ;
CLR C
ADD A,DPL
MOV DPL,A
MOV A,DPH
ADDC A,#00H    ;
MOV DPH,A
LCALL LCD_DIYIHANG_BIAOJI
LCALL LCD_DIERHANG
RET
ANJIAN_DOWN_CAIDAN_YE3:     ;
CJNE A,#3H,ANJIAN_DOWN_CAIDAN_YE4    ;
;.......
MOV A,LCD_CAIDAN
CJNE A,#0BH,ANJIAN_DOWN_CAIDANA    ;
MOV DPTR,#BIAO_LCD_TIME_JISHU    ;
LCALL LCD_DIYIHANG_BIAOJI    ;
MOV DPTR,#BIAO_LCD_TIME_SHIZHONG    ;
LCALL LCD_DIERHANG    ;
MOV LCD_CAIDAN,#09H    ;
RET
ANJIAN_DOWN_CAIDANA:
CJNE A,#0AH,ANJIAN_DOWN_JIESHU    ;
MOV DPTR,#BIAO_LCD_TIME_SHIZHONG    ;
LCALL LCD_DIYIHANG_BIAOJI    ;
MOV DPTR,#BIAO_LCD_TIME_JISHU    ;
LCALL LCD_DIERHANG    ;
RET
ANJIAN_DOWN_CAIDAN_YE4:     ;
CJNE A,#4H,ANJIAN_DOWN_CAIDAN_YE5    ;
;.....
ANJIAN_DOWN_CAIDANB:
MOV A,LCD_CAIDAN    ;
CJNE A,#0CH,ANJIAN_DOWN_JIESHU    ;
MOV DPTR,#BIAO_LCD_JISUANQI_QUEDING    ;
LCALL LCD_DIYIHANG
LCALL LCD_DIERHANG
MOV LCD_CAIDAN,#0BH    ;
RET
ANJIAN_DOWN_CAIDAN_YE5:      ;
CJNE A,#5,ANJIAN_DOWN_JIESHU    ;
;......
ANJIAN_DOWN_CAIDANC:
MOV A,LCD_CAIDAN
CJNE A,#0DH,ANJIAN_DOWN_JIESHU    ;
MOV DPTR,#BIAO_LCD_HONGWAI_QUEDING    ;
LCALL LCD_DIYIHANG
LCALL LCD_DIERHANG
MOV LCD_CAIDAN,#0BH    ;
RET
ANJIAN_DOWN_JIESHU:
RET
;..............
ANJIAN_EXIT:
MOV A,LCD_CAIDAN_YE    ;
CJNE A,#00H,ANJIAN_EXIT_CAIDAN_YE1    ;
MOV DPTR,#BIAO_LCD_LED    ;
LCALL LCD_DIYIHANG_BIAOJI    ;
LCALL LCD_DIERHANG    ;
INC LCD_CAIDAN
MOV LCD_CAIDAN_YE,#1H    ;
LJMP ANJIAN_EXIT_JIESHU    ;
ANJIAN_EXIT_CAIDAN_YE1:
CJNE A,#1H,ANJIAN_EXIT_CAIDAN_YE2345    ;若为页1无反应
LCALL FENGMING
AJMP ANJIAN_EXIT_JIESHU    ;
ANJIAN_EXIT_CAIDAN_YE2345:
MOV B,#6H
CLR C
SUBB A,B    ;判断是否小于6
JNC ANJIAN_EXIT_CAIDAN_YE6789    ;
MOV LCD_CAIDAN_YE,#1H    ;小于六显示页一
MOV LCD_CAIDAN,#2H    ;
LCALL ANJIAN_UP    ;
RET
ANJIAN_EXIT_CAIDAN_YE6789:    ;
MOV A,LCD_CAIDAN_YE    ;
CJNE A,#6H,ANJIAN_EXIT_CAIDAN_YE7    ;页6退出对应页2
MOV LCD_CAIDAN_YE,#2H    ;
MOV LCD_CAIDAN,#6H    ;
LCALL ANJIAN_UP    ;
RET
ANJIAN_EXIT_CAIDAN_YE7:
CJNE A,#7H,ANJIAN_EXIT_CAIDAN_YE8    ;页7退出对应页3
MOV LCD_CAIDAN_YE,#3H    ;
MOV LCD_CAIDAN,#0AH    ;
LCALL ANJIAN_UP    ;
RET
ANJIAN_EXIT_CAIDAN_YE8:
CJNE A,#8H,ANJIAN_EXIT_CAIDAN_YE9    ;页8退出对应页4
LCALL LCD_CHUSHIHUA
MOV LCD_CAIDAN_YE,#4H    ;
MOV LCD_CAIDAN,#0BH    ;
LCALL ANJIAN_UP    ;
RET
ANJIAN_EXIT_CAIDAN_YE9:
CJNE A,#9H,ANJIAN_EXIT_JIESHU    ;页9退出对应页5
MOV LCD_CAIDAN_YE,#5H    ;
MOV LCD_CAIDAN,#0CH    ;
LCALL ANJIAN_UP    ;
ANJIAN_EXIT_JIESHU:
RET

;............确定键

ANJIAN_OK:
LCALL FENGMING
MOV A,LCD_CAIDAN_YE    ;与退出键类似
CJNE A,#00H,ANJIAN_OK_CAIDAN_YE1    ;
MOV DPTR,#BIAO_LCD_LED    ;
LCALL LCD_DIYIHANG_BIAOJI    ;
LCALL LCD_DIERHANG    ;
INC LCD_CAIDAN    ;
MOV LCD_CAIDAN_YE,#1H    ;
LJMP ANJIAN_OK_JIESHU    ;
ANJIAN_OK_CAIDAN_YE1:
CJNE A,#01H,ANJIAN_OK_CAIDAN_YE2    ;
ANJIAN_OK_CAIDAN_LED:
MOV A,LCD_CAIDAN
CJNE A,#01H,ANJIAN_OK_CAIDAN_TIME    ;若为菜单1进入页二菜单5
MOV LCD_CAIDAN,#5H    ;
MOV LCD_CAIDAN_YE,#2H    ;
MOV DPTR,#BIAO_LCD_LED1    ;
LCALL LCD_DIYIHANG_BIAOJI    ;
MOV DPTR,#BIAO_LCD_LED2    ;
LCALL LCD_DIERHANG    ;
RET
ANJIAN_OK_CAIDAN_TIME:
CJNE A,#02H,ANJIAN_OK_CAIDAN_JISUANQI    ;
MOV LCD_CAIDAN_YE,#3H    ;若为菜单2进入页3菜单9
MOV LCD_CAIDAN,#9H    ;
MOV DPTR,#BIAO_LCD_TIME_JISHU    ;
LCALL LCD_DIYIHANG_BIAOJI    ;
MOV DPTR,#BIAO_LCD_TIME_SHIZHONG    ;
LCALL LCD_DIERHANG    ;
RET
ANJIAN_OK_CAIDAN_JISUANQI:
CJNE A,#03H,ANJIAN_OK_CAIDAN_HONGWAI    ;若为菜单3进入页4菜单11
MOV LCD_CAIDAN_YE,#4H    ;
MOV LCD_CAIDAN,#0BH    ;
MOV DPTR,#BIAO_LCD_JISUANQI_QUEDING    ;
LCALL LCD_DIYIHANG
LCALL LCD_DIERHANG
RET
ANJIAN_OK_CAIDAN_HONGWAI:
CJNE A,#04H,ANJIAN_OK_JIESHU_1    ;若为菜单4进入页二菜单12
MOV LCD_CAIDAN_YE,#5H    ;
MOV LCD_CAIDAN,#0CH    ;
MOV DPTR,#BIAO_LCD_HONGWAI_QUEDING    ;
LCALL LCD_DIYIHANG
LCALL LCD_DIERHANG
RET
ANJIAN_OK_CAIDAN_YE2:             ;若为页二
CJNE A,#02H,ANJIAN_OK_CAIDAN_YE3    ;
MOV DPTR,#BIAO_LCD_TUICHU    ;
LCALL LCD_DIYIHANG    ;
LCALL LCD_DIERHANG    ;
MOV LCD_CAIDAN_YE,#6H   ;........进入页6
MOV A,LCD_CAIDAN
CJNE A,#5H,ANJIAN_OK_YE2_LOOP0    ;根据菜单执行程序
LJMP LEDDIYI
ANJIAN_OK_JIESHU_1:
LJMP ANJIAN_OK_JIESHU 
RET
ANJIAN_OK_YE2_LOOP0:
CJNE A,#6H,ANJIAN_OK_YE2_LOOP1   ;
LJMP LEDDIER
RET
ANJIAN_OK_YE2_LOOP1:
CJNE A,#7H,ANJIAN_OK_YE2_LOOP2    ;
LJMP LEDDISAN
RET
ANJIAN_OK_YE2_LOOP2:
CJNE A,#8H,ANJIAN_OK_JIESHU    ;
LJMP LEDDISI
RET
ANJIAN_OK_CAIDAN_YE3:
CJNE A,#03H,ANJIAN_OK_CAIDAN_YE4   ;TIME的选择页面
MOV DPTR,#BIAO_LCD_TUICHU
LCALL LCD_DIYIHANG
LCALL LCD_DIERHANG
MOV LCD_CAIDAN_YE,#7H     ;TIME的退出界面
MOV A,LCD_CAIDAN
CJNE A,#9H,ANJIAN_OK_YE3_LOOP0 ;TIME的选项1，菜单9
LJMP SHUMA_DINGSHI
RET
ANJIAN_OK_YE3_LOOP0:
CJNE A,#0AH,ANJIAN_OK_JIESHU
LJMP SHUMA_SHIZHONG;TIME的选项2，菜单10
RET
ANJIAN_OK_CAIDAN_YE4:
CJNE A,#04H,ANJIAN_OK_CAIDAN_YE5    ;计算器
MOV DPTR,#BIAO_LCD_TUICHU    ;
LCALL LCD_DIYIHANG
LCALL LCD_DIERHANG
MOV LCD_CAIDAN_YE,#8H    ;
;;;;;MOV A,LCD_CAIDAN
LJMP JISUANQI

RET
ANJIAN_OK_CAIDAN_YE5:
CJNE A,#05H,ANJIAN_OK_JIESHU    ;红外
MOV DPTR,#BIAO_LCD_TUICHU    ;
LCALL LCD_DIYIHANG    ;
LCALL LCD_DIERHANG    ;
MOV LCD_CAIDAN_YE,#9H    ;
MOV A,LCD_CAIDAN
RET
ANJIAN_OK_JIESHU:
RET
;............按键判断		
			  ANJIAN_RENYI:
			  MOV A,HONGWAIZ_MA
			  CJNE A,#01H,ANJIAN_RENYI_HONGWAIDOWN
			  MOV HONGWAIZ_MA,#00H
			  LJMP ANJIAN_UP
			  ANJIAN_RENYI_HONGWAIDOWN:
			  CJNE A,#02H,ANJIAN_RENYI_HONGWAIOK
			  MOV HONGWAIZ_MA,#00H
			  LJMP ANJIAN_DOWN
			  ANJIAN_RENYI_HONGWAIOK:
			  CJNE A,#03H,ANJIAN_RENYI_UP
			  MOV HONGWAIZ_MA,#00H
			  LJMP ANJIAN_OK
			  ANJIAN_RENYI_UP:
			  JB KEY_UP,ANJIAN_RENYI_DOWN
			  LCALL DELAY10MS
			  JB KEY_UP,ANJIAN_RENYI_DOWN
			  JNB KEY_UP,$
			  LJMP ANJIAN_UP
			  ANJIAN_RENYI_DOWN:
			  JB KEY_DOWN,ANJIAN_RENYI_OK
			  LCALL DELAY10MS
			  JB KEY_DOWN,ANJIAN_RENYI_OK
			  JNB KEY_DOWN,$
			  LJMP ANJIAN_DOWN
			  ANJIAN_RENYI_OK:
			  JB KEY_OK,ANJIAN_RENYI_JIESHU
			  LCALL DELAY10MS
			  JB KEY_OK,ANJIAN_RENYI_JIESHU
			  JNB KEY_OK,$
			  LJMP ANJIAN_OK
			  ANJIAN_RENYI_EXIT:
			  JB KEY_EXIT,ANJIAN_RENYI_JIESHU
			  LCALL DELAY10MS
			  JB KEY_EXIT,ANJIAN_RENYI_JIESHU
			  JNB KEY_EXIT,$
			  LJMP ANJIAN_EXIT
			  ANJIAN_RENYI_JIESHU:
			  RET
			  
			  
LCD_CHAMANG:
MOV LCD_DATA,#0FFH
CLR LCD_RS
SETB LCD_RW
CLR LCD_E
NOP
SETB LCD_E
JB LCD_D7,LCD_CHAMANG
CLR LCD_E
RET

LCD_XIEMINGLING:
LCALL LCD_CHAMANG
                CLR LCD_RS    ;写命令rs=0，rw=0，e=0
                CLR LCD_RW     ;
				CLR LCD_E     ;
				MOV LCD_DATA,A  ;写入P0口
				SETB LCD_E     ;E下降沿
				LCALL DELAY1MS
				CLR LCD_E      ;
				RET
LCD_XIESHUJU:
LCALL LCD_CHAMANG
             SETB LCD_RS  ;rs=0，rw=1，e=1
              CLR LCD_RW       ; 写数据    
			 CLR LCD_E
			 MOV LCD_DATA,A    ;写入P0口
			 SETB LCD_E        ;下降沿
			  LCALL DELAY1MS
			 CLR LCD_E
			 RET
LCD_CHUSHIHUA: 
            CLR LCD_RS
            CLR LCD_RW
            CLR LCD_E
              MOV A,#38H
              LCALL LCD_XIEMINGLING
			  MOV A,#0CH
			  LCALL LCD_XIEMINGLING
			  MOV A,#06H
			   LCALL LCD_XIEMINGLING
			  MOV A,#01H
			  LCALL LCD_XIEMINGLING
			  RET
			  
			  LCD_DIYIHANG_BIAOJI:
			  MOV A,#80H
			  LCALL LCD_XIEMINGLING
			  MOV LCD_JISHU,#10H
			  LCD_DIYIHANG_BIAOJI_LOOP0:
			  MOV A,#00H
			  MOVC A,@A+DPTR
			  LCALL LCD_XIESHUJU
			  INC DPTR
			  DJNZ LCD_JISHU,LCD_DIYIHANG_BIAOJI_LOOP0
			  MOV A,#80H
			  LCALL LCD_XIEMINGLING
			  MOV A,#20H
			  LCALL LCD_XIESHUJU
			  MOV A,#81H
			  LCALL LCD_XIEMINGLING
			  MOV A,#7EH
			  LCALL LCD_XIESHUJU
			  RET
			  LCD_DIYIHANG:
			  MOV A,#80H
			  LCALL LCD_XIEMINGLING
			  MOV LCD_JISHU,#10H
			  LCD_DIYIHANG_LOOP0:
			  MOV A,#00H
			  MOVC A,@A+DPTR
			  LCALL LCD_XIESHUJU
			  INC DPTR
			  DJNZ LCD_JISHU,LCD_DIYIHANG_LOOP0
			  RET
			  
			    LCD_DIERHANG:
			  MOV A,#0C0H
			  LCALL LCD_XIEMINGLING
			  MOV LCD_JISHU,#10H
			  LCD_DIERHANG_LOOP0:
			  MOV A,#00H
			  MOVC A,@A+DPTR
			  LCALL LCD_XIESHUJU
			  INC DPTR
			  DJNZ LCD_JISHU,LCD_DIERHANG_LOOP0
			  RET
			  
			   LCD_DIYIHANG_DELAY:
			  MOV A,#80H
			  LCALL LCD_XIEMINGLING
			  MOV LCD_JISHU,#10H
			  LCD_DIYIHANG_DELAY_LOOP0:
			  MOV A,#00H
			  MOVC A,@A+DPTR
			  LCALL LCD_XIESHUJU
			  LCALL DELAY50MS
			  INC DPTR
			  DJNZ LCD_JISHU,LCD_DIYIHANG_DELAY_LOOP0
			  RET
			  
			    LCD_DIERHANG_DELAY:
			  MOV A,#0C0H
			  LCALL LCD_XIEMINGLING
			  MOV LCD_JISHU,#10H
			  LCD_DIERHANG_DELAY_LOOP0:
			  MOV A,#00H
			  MOVC A,@A+DPTR
			  LCALL LCD_XIESHUJU
			  LCALL DELAY50MS
			  INC DPTR
			  DJNZ LCD_JISHU,LCD_DIERHANG_DELAY_LOOP0
			  RET
DELAY300US:   ;误差 0us
    MOV R6,#21H
DL300U0:
    MOV R5,#03H
    DJNZ R5,$
    DJNZ R6,DL300U0
    RET
DELAY700US:   ;误差 0us
    MOV R6,#29H
DL700U0:
    MOV R5,#07H
    DJNZ R5,$
    DJNZ R6,DL700U0
    RET
DELAY4MS750US:   ;误差 0us
    MOV R6,#65H
DL4M750U0:
    MOV R5,#16H
    DJNZ R5,$
    DJNZ R6,DL4M750U0
    RET
DELAY840US:   ;误差 0us
    MOV R6,#5DH
DL840U0:
    MOV R5,#03H
    DJNZ R5,$
    DJNZ R6,DL840U0
    RET
DELAY1MS:
    MOV R7,#01H
YIDL1:
    MOV R6,#8EH
YIDL0:
    MOV R5,#02H
    DJNZ R5,$
    DJNZ R6,YIDL0
    DJNZ R7,YIDL1
    RET
	
	DELAY10MS:   ;误差 0us
    MOV R7,#01H
SHIDL1:
    MOV R6,#26H
SHIDL0:
    MOV R5,#82H
    DJNZ R5,$
    DJNZ R6,SHIDL0
    DJNZ R7,SHIDL1
    RET
	
	DELAY50MS:   ;误差 0us
    MOV R6,#0ADH
WUSHIDL0:
    MOV R5,#8FH
    DJNZ R5,$
    DJNZ R6,WUSHIDL0
    RET
DELAY100MS:   ;误差 0us
    MOV R7,#13H
YIBAIDL1:
    MOV R6,#14H
YIBAIDL0:
    MOV R5,#82H
    DJNZ R5,$
    DJNZ R6,YIBAIDL0
    DJNZ R7,YIBAIDL1
    RET
DELAY1S:   ;误差 0us
    MOV R7,#0A7H
DLYIMIAO1:
    MOV R6,#0ABH
DLYIMIAO0:
    MOV R5,#10H
    DJNZ R5,$
    DJNZ R6,DLYIMIAO0
    DJNZ R7,DLYIMIAO1
    NOP
    RET
	BIAO_LCD_HUANYING1:
DB " WELCOME TO USE "
	BIAO_LCD_HUANYING2:
	DB "  Here is 509   "
;表1---ZHU
	BIAO_LCD_LED:
	DB "      LED       "  
	BIAO_LCD_TIME:
	DB "      TIME      "
	BIAO_LCD_JISUANQI:
	DB "    JISUANQI    "
	BIAO_LCD_HONGWAI:
	DB "    HONGWAI     "
;表2---LED;;;LED--,5,6,7,8
BIAO_LCD_LED1:
DB "       NB1      "
BIAO_LCD_LED2:
DB "       NB2      "
BIAO_LCD_LED3:
DB "       NB3      "
BIAO_LCD_LED4:
DB "       NB4      "
;表3---time---9,A
BIAO_LCD_TIME_JISHU:
DB "     JISHIQI    "
BIAO_LCD_TIME_SHIZHONG:
DB "    SHIZHONG    "
;表4----计算器-B
BIAO_LCD_JISUANQI_QUEDING:
DB "     ZHESHI     ",20H,7EH,"  JISUANQI    "
;表5----红外线 -C
BIAO_LCD_HONGWAI_QUEDING:
DB "    HAIBUHUI    ",20H,7EH,"  HONGWAI     "
BIAO_LCD_TUICHU:
DB"ZHENGZAIYUNXING   TUCHU",20H,7EH,"EXIT   "
BIAO_SHUZI:
DB 0x7B,0x41,0x7C,0x75,0x47,0x37,0x3F,0x61,0x7F,0x77,00H,0x6F,0x1F,0x3A,0x5D,0x3E,0x2E ;新
DB 0FDH,60H,0DBH,0F3H,067H,0B7H,0BFH,0E1H,0FFH,0E7H,00H ;abcdefg
DB 0DFH,011H,0FAH,0BBH,0B5H,0AFH,0EFH,093H,0FFH,0B7H,00H ;xuezhang
BIAO_LCD_JISUANQI_ZIFU:
DB "0123456789+-*/=."
END